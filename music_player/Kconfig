## music_player/Kconfig
```kconfig
#
# For a description of the syntax of this configuration file,
# see the file kconfig-language.txt in the NuttX tools repository.
#

config LVX_USE_DEMO_MUSIC_PLAYER
	bool "Music Player"
	default n
	
if LVX_USE_DEMO_MUSIC_PLAYER
	config LVX_MUSIC_PLAYER_DATA_ROOT
		string "Music Player Data Root"
		default "/sdcard"

	config LVX_MUSIC_PLAYER_MP3_SUPPORT
		bool "Enable MP3 audio format support"
		default n
		depends on LIB_MAD
		help
		  Enable MP3 audio format support using libmad decoder.
		  This allows the music player to play MP3 files in addition to WAV files.

	config LVX_MUSIC_PLAYER_MP3_BUFFER_SIZE
		int "MP3 decode buffer size"
		default 8192
		depends on LVX_MUSIC_PLAYER_MP3_SUPPORT
		help
		  Size of the buffer used for MP3 decoding in bytes.
		  Larger buffers may improve performance but use more memory.
endif
```
